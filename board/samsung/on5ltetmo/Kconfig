## board/samsung/on5ltetmo/Kconfig
```kconfig
if TARGET_ON5LTETMO

config SYS_BOARD
	default "on5ltetmo"

config SYS_VENDOR
	default "samsung"

config SYS_CONFIG_NAME
	default "on5ltetmo"

endif
```

## board/samsung/xcover3ve/Kconfig
```kconfig
if TARGET_XCOVER3VE

config SYS_BOARD
	default "xcover3ve"
	help
	  Xcover3ve is a production board for SM-G389F phone on Exynos3475 SoC.

config SYS_VENDOR
	default "samsung"

config SYS_CONFIG_NAME
	default "xcover3ve"

endif
```

## configs/on5ltetmo_defconfig
```kconfig
CONFIG_ARM=y
CONFIG_SKIP_LOWLEVEL_INIT=y
CONFIG_SYS_CONFIG_NAME="exynos3475-common"
CONFIG_COUNTER_FREQUENCY=26000000
CONFIG_ARCH_EXYNOS=y
CONFIG_TEXT_BASE=0x20008000
CONFIG_SYS_MALLOC_LEN=0x5004000
CONFIG_SYS_MALLOC_F_LEN=0x400
CONFIG_ARCH_EXYNOS3=y
CONFIG_TARGET_ON5LTETMO=y
CONFIG_HAS_CUSTOM_SYS_INIT_SP_ADDR=y
CONFIG_CUSTOM_SYS_INIT_SP_ADDR=0x20400000
CONFIG_DEFAULT_DEVICE_TREE="exynos3475-on5ltetmo"
CONFIG_SYS_LOAD_ADDR=0x20001000
CONFIG_FIT=y
# CONFIG_DISPLAY_CPUINFO is not set
CONFIG_CMD_GPIO=y
```

## configs/xcover3ve_defconfig
```kconfig
CONFIG_ARM=y
CONFIG_ARCH_EXYNOS=y
CONFIG_ARCH_EXYNOS3=y
CONFIG_S5P=y
CONFIG_TARGET_XCOVER3VE=y
# This option is a number of 256MB DRAM banks, i.e. (ram size) / 256MB.
# Used in samsung common board dram_init function.
CONFIG_NR_DRAM_BANKS=8
CONFIG_SYS_CONFIG_NAME="exynos3-common"
CONFIG_DEFAULT_DEVICE_TREE="exynos3475-xcover3ve"
CONFIG_SYS_TEXT_BASE=0x20008000
CONFIG_SYS_LOAD_ADDR=0x20008000
CONFIG_HUSH_PARSER=y
CONFIG_FIT=y
CONFIG_BOARD_EARLY_INIT_F=n
CONFIG_SKIP_LOWLEVEL_INIT=y
CONFIG_CMD_GPIO=y
CONFIG_DISPLAY_CPUINFO=n
CONFIG_CMD_I2C=y
CONFIG_DM_I2C_GPIO=y
# CONFIG_DEBUG_UART_S5P=y
# CONFIG_DEBUG_UART_BASE=0x13820000 
```

## drivers/pinctrl/exynos/Kconfig
```kconfig
config PINCTRL_EXYNOS
	bool

config PINCTRL_EXYNOS7420
	bool "Samsung Exynos7420 pinctrl driver"
	depends on ARCH_EXYNOS && PINCTRL_FULL
	select PINCTRL_EXYNOS
	help
	  Support pin multiplexing and pin configuration control on
	  Samsung's Exynos7420 SoC.

config PINCTRL_EXYNOS78x0
	bool "Samsung Exynos78x0 pinctrl driver"
	depends on ARCH_EXYNOS && PINCTRL_FULL
	select PINCTRL_EXYNOS
	help
	  Support pin multiplexing and pin configuration control on
	  Samsung's Exynos78x0 SoC.

config PINCTRL_EXYNOS3475
	bool "Samsung Exynos3475 pinctrl driver"
	depends on ARCH_EXYNOS && PINCTRL_FULL
	select PINCTRL_EXYNOS
	help
	  Support pin multiplexing and pin configuration control on
	  Samsung's Exynos3475 SoC.
```
